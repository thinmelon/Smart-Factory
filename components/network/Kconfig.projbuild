## components/network/Kconfig.projbuild
```kconfig
menu "Network Configuration"
    menu "Network Selection"
        config NETWORK_USE_WIFI
            bool "Enable WiFi configuration"
            default y
        config NETWORK_USE_LORA
            bool "Enable LoRa configuration"
            default n

        menu "LoRa Role Configuration"
            depends on NETWORK_USE_LORA
            choice LORA_ROLE
                prompt "Device role in the LoRa network."
                default LORA_ROLE_MASTER
                help
                    Device role in the LoRa network.

                config LORA_ROLE_MASTER
                    bool "MASTER"
                config LORA_ROLE_SLAVE
                    bool "SLAVE"
            endchoice
        endmenu
    endmenu

    menu "Network Provisioning Selection"
        config NETWORK_PROVISIONING_SMARTCONFIG
            bool "Enable SmartConfig's smart network configuration method"
            default y
            help
                Enable SmartConfig's smart network configuration method
        
        config NETWORK_PROVISIONING_SOFTAPCONFIG
            bool "Enable SoftAP's network configuration method"
            default n
            help
                "Enable SoftAP's network configuration method"

        config NETWORK_PROVISIONING_BLECONFIG
            depends on IDF_TARGET_ESP32 || IDF_TARGET_ESP32C3
            bool "Enable BLE's network configuration method"
            default n
            help
                "Enable BLE's network configuration method"

        config NETWORK_PROVISIONING_SOFTAPCONFIG_SSID
            depends on NETWORK_PROVISIONING_SOFTAPCONFIG
            string "SoftAP ssid"
            default "tcloud_XXX"
            help
                SSID (network name) for the phone to connect to.

        config NETWORK_PROVISIONING_SOFTAPCONFIG_PASSWORD
            depends on NETWORK_PROVISIONING_SOFTAPCONFIG
            string "SoftAP password"
            default ""
            help
                WiFi password (WPA or WPA2) for the example to use.
                Can be left blank if the network has no security set.

        config NETWORK_PROVISIONING_BLECONFIG_NAME
            depends on NETWORK_PROVISIONING_BLECONFIG
            string "BLE name"
            default "EBOOK"
            help
                BLE for the phone to connect to.

        config NETWORK_WIFI_AUTH_OPEN
            bool "Enable authenticate mode : open"
            default n
            help
                Enable authenticate mode : open
        
        config NETWORK_WIFI_AUTH_OPEN_SSID
            depends on NETWORK_WIFI_AUTH_OPEN
            string "WiFi SSID"
            default  ""
            help
                SSID (network name) for the device to connect to.
    endmenu
            
    menu "LoRa SPI GPIO Configuration"
        config CS_GPIO
            int "CS GPIO"
            range 0 35
            default 5
            help
            Pin Number where the NCS pin of the LoRa module is connected to.
        
        config RST_GPIO
            int "RST GPIO"
            range 0 35
            default 4
            help
            Pin Number where the NRST pin of the LoRa module is connected to.
        
        config MISO_GPIO
            int "MISO GPIO"
            range 0 35
            default 19
            help
            Pin Number to be used as the MISO SPI signal.
        
        config MOSI_GPIO
            int "MOSI GPIO"
            range 0 35
            default 23
            help
            Pin Number to be used as the MOSI SPI signal.
        
        config SCK_GPIO
            int "SCK GPIO"
            range 0 35
            default 18
            help
            Pin Number to be used as the SCK SPI signal.
    
        config TX_ENABLE_GPIO
            int "RADIO TX ENABLE GPIO"
            range 0 35
            default 21
            help
            Pin Number to be used as the TX enable signal.
    
        config RX_ENABLE_GPIO
            int "RADIO RX ENABLE GPIO"
            range 0 35
            default 22
            help
            Pin Number to be used as the RX enable signal.
    endmenu
endmenu
```

## components/peripherals/Kconfig.projbuild
```kconfig
menu "Peripherals Configuration"
    menu "GPIO LED configuration"
        config GPIO_LED_GREEN
            int "Light green pin GPIO number"
            range 0 46
            default 27
            help
                There are more enumerations like that
                up to GPIO39, excluding GPIO20, GPIO24 and GPIO28..31.
                They are not shown here to reduce redundant information.
                @note GPIO34..39 are input mode only.
    endmenu

    menu "GPIO device control configuration"
        config GPIO_DEVICE_RESET
            int "Reset device counting number pin GPIO number"
            range 0 46
            default 26
            help
                There are more enumerations like that
                up to GPIO39, excluding GPIO20, GPIO24 and GPIO28..31.
                They are not shown here to reduce redundant information.
                @note GPIO34..39 are input mode only.
        config GPIO_DEVICE_COUNTING
            int "Record device counting number pin GPIO number"
            range 0 46
            default 25
            help
                There are more enumerations like that
                up to GPIO39, excluding GPIO20, GPIO24 and GPIO28..31.
                They are not shown here to reduce redundant information.
                @note GPIO34..39 are input mode only.
    endmenu

    menu "Button configuration"
        config IO_GLITCH_FILTER_TIME_MS
            int "IO glitch filter timer ms (10~100)"
            range 10 100
            default 50
    endmenu

    menu "I2C Master configuration"
        config I2C_MASTER_SCL
            int "SCL GPIO Num"
            default 6 if IDF_TARGET_ESP32C3
            default 19 if IDF_TARGET_ESP32 || IDF_TARGET_ESP32S2 || IDF_TARGET_ESP32S3
            help
                GPIO number for I2C Master clock line.

        config I2C_MASTER_SDA
            int "SDA GPIO Num"
            default 5 if IDF_TARGET_ESP32C3
            default 18 if IDF_TARGET_ESP32 || IDF_TARGET_ESP32S2 || IDF_TARGET_ESP32S3
            help
                GPIO number for I2C Master data line.

        config I2C_MASTER_PORT_NUM
            int "Port Number"
            default 1 if IDF_TARGET_ESP32 || IDF_TARGET_ESP32S2 || IDF_TARGET_ESP32S3
            default 0 if IDF_TARGET_ESP32C3
            help
                Port number for I2C Master device.

        config I2C_MASTER_FREQUENCY
            int "Master Frequency"
            default 100000
            help
                I2C Speed of Master device.
    endmenu

    menu "I2C Slave configuration"
        config I2C_SLAVE_SCL
            int "SCL GPIO Num"
            default 5
            help
                GPIO number for I2C Slave clock line.

        config I2C_SLAVE_SDA
            int "SDA GPIO Num"
            default 4
            help
                GPIO number for I2C Slave data line.

        config I2C_SLAVE_PORT_NUM
            int "Port Number"
            default 0
            help
                Port number for I2C Slave device.

        config I2C_SLAVE_ADDRESS
            hex "ESP Slave Address"
            default 0x28
            help
                Hardware Address of I2C Slave Port.
    endmenu

    menu "OLED Screen configuration"
        config OLED_COLUMN_PIXEL
            int "Column Pixel Num"
            default 128
            help
                Column pixel numer for OLED screen.

        config OLED_ROW_PIXEL
            int "Row Pixel Num"
            default 64
            help
                Row pixel numer for OLED screen.
    endmenu

endmenu
```
